#include "DDUpdateUploadServer.h"

#ifdef USE_HTML_MIN_GZ
#define update_min_htm_gz_len 1739
static const char update_min_htm_gz[] PROGMEM = {
  0x1f, 0x8b, 0x08, 0x08, 0x12, 0x7c, 0x3d, 0x5c, 0x04, 0x00, 0x75, 0x70,
  0x64, 0x61, 0x74, 0x65, 0x2e, 0x6d, 0x69, 0x6e, 0x2e, 0x68, 0x74, 0x6d,
  0x00, 0x95, 0x57, 0x59, 0x13, 0x93, 0x30, 0x10, 0xfe, 0x2b, 0x11, 0xc7,
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  0xff, 0xe1, 0x1f, 0x78, 0x62, 0xe0, 0x81, 0x25, 0x0f, 0x00, 0x00
};

#define upload_min_htm_gz_len 1636
static const char upload_min_htm_gz[] PROGMEM = {
  0x1f, 0x8b, 0x08, 0x08, 0x34, 0x1f, 0x38, 0x5c, 0x04, 0x00, 0x75, 0x70,
  0x6c, 0x6f, 0x61, 0x64, 0x2e, 0x6d, 0x69, 0x6e, 0x2e, 0x68, 0x74, 0x6d,
  0x00, 0x9d, 0x57, 0x5b, 0xef, 0x93, 0x30, 0x14, 0xff, 0x2a, 0x15, 0x63,
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  0x24, 0x0e, 0x00, 0x00
};
#endif

#ifndef USE_HTML_MIN_GZ
static const char updateIndex[] PROGMEM = R"=====(
<!DOCTYPE html><html><meta http-equiv="Content-Type" content="text/html; charset=utf-8"><meta name="viewport" content="width=device-width,initial-scale=0.5"><head><style>body{margin:0;height:100vh;display:flex;flex-direction:column;justify-content:center;background-color:#95b195}#dropFileForm{margin:auto 100px;text-align:center;border-radius:8px;overflow:hidden;transition:.5s}#dropFileForm #fileLabel{background-color:rgba(0,255,0,.5);display:block;padding:24px;position:relative;cursor:pointer}#dropFileForm #fileInput{display:none}#dropFileForm #fileLabel:after,#dropFileForm #fileLabel:before{position:absolute;content:"";top:0;bottom:0;left:0;right:0;background-color:#fff;z-index:-2;border-radius:8px 8px 0 0}#dropFileForm #fileLabel:before{z-index:-1;background:repeating-linear-gradient(45deg,transparent,transparent 5%,#000 5%,#000 10%);opacity:0;transition:.5s}#dropFileForm.fileHover #fileLabel:before{opacity:.25}#dropFileForm.uploadButton{border:0;outline:0;width:100%;padding:8px;font-size:50px;background-color:#32cd32;color:#fff;cursor:pointer}#dropFileForm.fileHover{box-shadow:0 0 16px #32cd32}#fileLabelText{color:#000;font-size:40px;font-family:Arial,Helvetica,sans-serif}#uploadStatus{color:rgb(112,0,0);font-size:30px;font-family:Arial,Helvetica,sans-serif}</style></head><body><form id="dropFileForm" action="/update" method="post" onsubmit="uploadFiles(event)"><input type="file" name="files[]" id="fileInput" onchange="addFiles(event)" accept=".bin"><label for="fileInput" id="fileLabel" ondragover="overrideDefault(event),fileHover()" ondragenter="overrideDefault(event),fileHover()" ondragleave="overrideDefault(event),fileHoverEnd()" ondrop="overrideDefault(event),fileHoverEnd(),addFiles(event)"><svg width="350" height="350" viewBox="0 0 2048 1792" xmlns="http://www.w3.org/2000/svg"><path d="M1344 864q0-14-9-23l-352-352q-9-9-23-9t-23 9l-351 351q-10 12-10 24 0 14 9 23t23 9h224v352q0 13 9.5 22.5t22.5 9.5h192q13 0 22.5-9.5t9.5-22.5v-352h224q13 0 22.5-9.5t9.5-22.5zm640 288q0 159-112.5 271.5t-271.5 112.5h-1088q-185 0-316.5-131.5t-131.5-316.5q0-130 70-240t188-165q-2-30-2-43 0-212 150-362t362-150q156 0 285.5 87t188.5 231q71-62 166-62 106 0 181 75t75 181q0 76-41 138 130 31 213.5 135.5t83.5 238.5z"/></svg><br><span id="fileLabelText">Choose firmware.bin or drag it here</span><br><span id="uploadStatus"></span></label><input type="submit" value="Update Firmware" class="uploadButton"></form><script>function overrideDefault(e){e.preventDefault(),e.stopPropagation()}function fileHover(){dropFileForm.classList.add("fileHover")}function fileHoverEnd(){dropFileForm.classList.remove("fileHover")}function addFiles(e){droppedFiles=e.target.files||e.dataTransfer.files,showFiles(droppedFiles)}function showFiles(e){"bin"!=e[0].name.split(".").pop()?(fileLabelText.innerText="STOP: Only choose .bin file !!!",alert("STOP: Only choose .bin file !!!"),fileInput.value="",dropFileForm.reset()):fileLabelText.innerText=e[0].name}function uploadFiles(e){e.preventDefault();if(fileInput.files.length==0){fileLabelText.innerText="Select at least 1 file!"}else{changeStatus("Uploading...");var t=new FormData;t.append(fileInput.name,droppedFiles[0],droppedFiles[0].name),fetch(dropFileForm.action,{method:dropFileForm.method,body:t}).then(function(e){if(e.ok){return e.text()}throw new Error('Network response was not ok.')}).then(function(html){console.log(`html=${html}`)}).catch(function(e){changeStatus("Error: "+e.message);console.log('Error: ',e.message);setTimeout(function(){location.reload()},5000)})}}function changeStatus(e){uploadStatus.innerText=e}var dropFileForm=document.getElementById("dropFileForm"),fileLabelText=document.getElementById("fileLabelText"),uploadStatus=document.getElementById("uploadStatus"),fileInput=document.getElementById("fileInput"),droppedFiles</script></body></html>
)=====";

static const char uploadIndex[] PROGMEM = R"=====(
<!DOCTYPE html><html><meta http-equiv="Content-Type" content="text/html; charset=utf-8"><meta name="viewport" content="width=device-width,initial-scale=0.5"><head><style>body{margin:0;height:100vh;display:flex;flex-direction:column;justify-content:center;background-color:#c2a4c0}#dropFileForm{margin:auto 100px;text-align:center;border-radius:8px;overflow:hidden;transition:.5s}#dropFileForm #fileLabel{background-color:rgba(247,0,255,.5);display:block;padding:24px;position:relative;cursor:pointer}#dropFileForm #fileInput{display:none}#dropFileForm #fileLabel:after,#dropFileForm #fileLabel:before{position:absolute;content:"";top:0;bottom:0;left:0;right:0;background-color:#fff;z-index:-2;border-radius:8px 8px 0 0}#dropFileForm #fileLabel:before{z-index:-1;background:repeating-linear-gradient(45deg,transparent,transparent 5%,#000 5%,#000 10%);opacity:0;transition:.5s}#dropFileForm.fileHover #fileLabel:before{opacity:.25}#dropFileForm .uploadButton{border:0;outline:0;width:100%;padding:8px;font-size:50px;background-color:#970183;color:#fff;cursor:pointer}#dropFileForm.fileHover{box-shadow:0 0 16px #32cd32}#fileLabelText{color:#000;font-size:40px;font-family:Arial,Helvetica,sans-serif}</style></head><body><form id="dropFileForm" action="/upload" method="post" onsubmit="uploadFiles(event)"><input type="file" name="files[]" id="fileInput" multiple onchange="addFiles(event)"><label for="fileInput" id="fileLabel" ondragover="overrideDefault(event),fileHover()" ondragenter="overrideDefault(event),fileHover()" ondragleave="overrideDefault(event),fileHoverEnd()" ondrop="overrideDefault(event),fileHoverEnd(),addFiles(event)"><svg width="300" height="300" viewBox="0 0 1792 1792" xmlns="http://www.w3.org/2000/svg"><path d="M1344 1344q0-26-19-45t-45-19-45 19-19 45 19 45 45 19 45-19 19-45zm256 0q0-26-19-45t-45-19-45 19-19 45 19 45 45 19 45-19 19-45zm128-224v320q0 40-28 68t-68 28h-1472q-40 0-68-28t-28-68v-320q0-40 28-68t68-28h465l135 136q58 56 136 56t136-56l136-136h464q40 0 68 28t28 68zm-325-569q17 41-14 70l-448 448q-18 19-45 19t-45-19l-448-448q-31-29-14-70 17-39 59-39h256v-448q0-26 19-45t45-19h256q26 0 45 19t19 45v448h256q42 0 59 39z"/></svg><br><span id="fileLabelText">Choose multiple files or drag them here</span><br><span id="uploadStatus"></span></label><input type="submit" value="Upload to SPIFFs" class="uploadButton"></form><script>function overrideDefault(e){e.preventDefault(),e.stopPropagation()}function fileHover(){dropFileForm.classList.add("fileHover")}function fileHoverEnd(){dropFileForm.classList.remove("fileHover")}function addFiles(e){droppedFiles=e.target.files||e.dataTransfer.files,showFiles(droppedFiles)}function showFiles(e){noOfFiles=e.length,e.length>1?fileLabelText.innerText=e.length+" files selected":fileLabelText.innerText=e[0].name}function uploadFiles(e){if(e.preventDefault(),0==noOfFiles)fileLabelText.innerText="Select at least 1 file!";else{changeStatus("Uploading...");for(var t,o=new FormData,n=0;t=droppedFiles[n];n++)o.append(fileInput.name,t,t.name);fetch(dropFileForm.action,{method:dropFileForm.method,body:o}).then(function(e){if(e.ok)return e.text();throw new Error("Network response was not ok.")}).then(function(e){setTimeout(function(){console.log("OK: ",e),location.reload()},500)}).catch(function(e){console.log("Error: ",e.message)})}}function changeStatus(e){uploadStatus.innerText=e}var dropFileForm=document.getElementById("dropFileForm"),fileLabelText=document.getElementById("fileLabelText"),uploadStatus=document.getElementById("uploadStatus"),fileInput=document.getElementById("fileInput"),droppedFiles,noOfFiles=0</script></body></html>
)=====";
#endif

//static const char successResponse[] PROGMEM = "<META http-equiv='refresh' content='15;URL=/update'>Update Success! Rebooting...\n";

DDUpdateUploadServer::DDUpdateUploadServer(bool serial_debug, const fs::FS& fs):_fs(fs)
{
  _serial_output = serial_debug;
  _server = NULL;
  _username = emptyString;
  _password = emptyString;
  _authenticated = false;
}

void DDUpdateUploadServer::setup(ESP8266WebServer *server, const String &path, const String &username, const String &password)
{
  _server = server;
  _username = username;
  _password = password;

  if (Serial)
  {
    Serial.println("\n\n---------------------------");
    Serial.println("Starting SPIFFs...");
  }
  if (_fs.begin())
  {
    Dir dir = _fs.openDir("/");
    while (dir.next())
    {
      String fileName = dir.fileName();
      size_t fileSize = dir.fileSize();
      if (Serial)
        Serial.printf("FS File: %s, size: %dB\n", fileName.c_str(), fileSize);
    }

    FSInfo fs_info;
    _fs.info(fs_info);
    if (Serial)
    {
      Serial.printf("FS Usage: %d/%d bytes\n", fs_info.usedBytes, fs_info.totalBytes);
      Serial.println("SPIFFs started");
      Serial.println("---------------------------");
    }
  }

  // handler for the /update form page
  _server->on(path.c_str(), HTTP_GET, [&]() {
    if (_username != emptyString && _password != emptyString && !_server->authenticate(_username.c_str(), _password.c_str()))
      return _server->requestAuthentication();
#ifdef USE_HTML_MIN_GZ
    _server->sendHeader("Content-Encoding", "gzip", true);
    _server->send_P(200, PSTR("text/html"), update_min_htm_gz, update_min_htm_gz_len);
#else
    _server->send_P(200, PSTR("text/html"), updateIndex);
#endif
  });

  // handler for the /update form POST (once file upload finishes)
  _server->on(path.c_str(), HTTP_POST, [&]() {
      if(!_authenticated)
        return _server->requestAuthentication();
      if (Update.hasError()) {
        _server->send(200, F("text/plain"), String(F("Update error: ")) + _updaterError);
      } else {
        _server->client().setNoDelay(true);
        _server->send(200, PSTR("text/plain"), String(F("Update OK")));
        delay(100);
        _server->client().stop();
        ESP.restart();
      } }, [&]() {
      // handler for the file upload, get's the sketch bytes, and writes
      // them through the Update object
      HTTPUpload& upload = _server->upload();

      if(upload.status == UPLOAD_FILE_START){
        _updaterError = String();
        if (_serial_output)
          Serial.setDebugOutput(true);

        _authenticated = (_username == emptyString || _password == emptyString || _server->authenticate(_username.c_str(), _password.c_str()));
        if(!_authenticated){
          if (_serial_output)
            Serial.printf("Unauthenticated Update\n");
          return;
        }

        WiFiUDP::stopAll();
        if (_serial_output)
          Serial.printf("Update: %s\n", upload.filename.c_str());
        uint32_t maxSketchSpace = (ESP.getFreeSketchSpace() - 0x1000) & 0xFFFFF000;
        if(!Update.begin(maxSketchSpace)){//start with max available size
          _setUpdaterError();
        }
      } else if(_authenticated && upload.status == UPLOAD_FILE_WRITE && !_updaterError.length()){
        if (_serial_output) Serial.printf(".");
        if(Update.write(upload.buf, upload.currentSize) != upload.currentSize){
          _setUpdaterError();
        }
      } else if(_authenticated && upload.status == UPLOAD_FILE_END && !_updaterError.length()){
        if(Update.end(true)){ //true to set the size to the current progress
          if (_serial_output) Serial.printf("\nUpdate Success: %u\nRebooting...\n", upload.totalSize);
        } else {
          _setUpdaterError();
        }
        if (_serial_output) Serial.setDebugOutput(false);
      } else if(_authenticated && upload.status == UPLOAD_FILE_ABORTED){
        Update.end();
        if (_serial_output) Serial.println("Update was aborted");
      }
      delay(0); });

  // handler for the /upload form page
  _server->on("/upload", HTTP_GET, [&]() {
    if (_username != emptyString && _password != emptyString && !_server->authenticate(_username.c_str(), _password.c_str()))
      return _server->requestAuthentication();
#ifdef USE_HTML_MIN_GZ
    _server->sendHeader("Content-Encoding", "gzip", true);
    _server->send_P(200, PSTR("text/html"), upload_min_htm_gz, upload_min_htm_gz_len);
#else
    _server->send_P(200, PSTR("text/html"), uploadIndex);
#endif
  });

  _server->on("/upload", HTTP_POST, [&]() { _server->send(200, "text/plain", "Upload success!"); }, [&]() {
      if (_server->uri() != "/upload") {
        return;
      }
      HTTPUpload& upload = _server->upload();
      if (upload.status == UPLOAD_FILE_START) {
        String filename = upload.filename;
        if (!filename.startsWith("/")) {
          filename = "/" + filename;
        }
        if (_serial_output) { Serial.print("handleFileUpload Name: "); Serial.println(filename); }
        fsUploadFile = _fs.open(filename, "w");
        filename = String();
      } else if (upload.status == UPLOAD_FILE_WRITE) {
        //if (_serial_output)  { Serial.print("handleFileUpload Data: "); Serial.println(upload.currentSize); }
        if (fsUploadFile) {
          fsUploadFile.write(upload.buf, upload.currentSize);
        }
      } else if (upload.status == UPLOAD_FILE_END) {
        if (fsUploadFile) {
          fsUploadFile.close();
        }
        if (_serial_output) { Serial.print("handleFileUpload Size: "); Serial.println(upload.totalSize); }
      }      
      });
}

void DDUpdateUploadServer::_setUpdaterError()
{
  if (_serial_output)
    Update.printError(Serial);
  StreamString str;
  Update.printError(str);
  _updaterError = str.c_str();
}
